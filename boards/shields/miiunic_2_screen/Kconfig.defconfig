## boards/shields/miiunic_2_screen/Kconfig.defconfig
```kconfig
if SHIELD_MIIUNIC_2_SCREEN_LEFT

# Name must be less than 16 characters long!
config ZMK_KEYBOARD_NAME
    default "miiUnic_2_Screen"

config ZMK_SPLIT_ROLE_CENTRAL
    default y

config ZMK_SPLIT_BLE_CENTRAL_PERIPHERALS
  default 1

config BT_MAX_CONN
  default 6

config BT_MAX_PAIRED
  default 6

endif

if SHIELD_MIIUNIC_2_SCREEN_LEFT || SHIELD_MIIUNIC_2_SCREEN_RIGHT

config ZMK_SPLIT
    default y

endif

if SHIELD_MIIUNIC_2_SCREEN_DONGLE

# Name must be less than 16 characters long!
config ZMK_KEYBOARD_NAME
    default "miiUnic_2_Screen"

config ZMK_SPLIT
    default y

config ZMK_SPLIT_ROLE_CENTRAL
    default y

config ZMK_SPLIT_BLE_CENTRAL_PERIPHERALS
  default 2

config BT_MAX_CONN
  default 7

config BT_MAX_PAIRED
  default 7

endif

# ---------------------
# Kconfig for shield "miiunic_2_screen_left" with board "nice_nano_v2"
# ---------------------
if BOARD_NICE_NANO_V2 && SHIELD_MIIUNIC_2_SCREEN_LEFT

config SPI
    default y

endif

# ---------------------
# Kconfig for shield "miiunic_2_screen_right" with board "nice_nano_v2"
# ---------------------
if BOARD_NICE_NANO_V2 && SHIELD_MIIUNIC_2_SCREEN_RIGHT

config SPI
    default y

endif
```

## boards/shields/miiunic_2_screen/Kconfig.shield
```kconfig
config SHIELD_MIIUNIC_2_SCREEN_LEFT
    def_bool $(shields_list_contains,miiunic_2_screen_left)
  
config SHIELD_MIIUNIC_2_SCREEN_RIGHT
    def_bool $(shields_list_contains,miiunic_2_screen_right)
  
config SHIELD_MIIUNIC_2_SCREEN_DONGLE
    def_bool $(shields_list_contains,miiunic_2_screen_dongle)
```
